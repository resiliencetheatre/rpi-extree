## configs/raspberrypizero2w_64_media_defconfig
```kconfig
BR2_aarch64=y
BR2_ARM_FPU_VFPV4=y
BR2_PACKAGE_HOST_LINUX_HEADERS_CUSTOM_6_18=y
BR2_BINUTILS_VERSION_2_44_X=y
BR2_TOOLCHAIN_BUILDROOT_CXX=y
BR2_GLOBAL_PATCH_DIR="${BR2_EXTERNAL}/board/raspberrypi/patches ${BR2_EXTERNAL}/patches"
BR2_DOWNLOAD_FORCE_CHECK_HASHES=y
BR2_TARGET_GENERIC_HOSTNAME="pttzero"
BR2_TARGET_GENERIC_ISSUE="Welcome to pttzero"
BR2_INIT_SYSTEMD=y
BR2_TARGET_GENERIC_ROOT_PASSWD="root"
BR2_SYSTEM_DEFAULT_PATH="/bin:/sbin:/usr/bin:/usr/sbin"
BR2_ROOTFS_OVERLAY="${BR2_EXTERNAL}/fs_overlay/fs_zero"
BR2_ROOTFS_POST_BUILD_SCRIPT="${BR2_EXTERNAL}/board/raspberrypizero2w-64/post-build.sh"
BR2_ROOTFS_POST_IMAGE_SCRIPT="${BR2_EXTERNAL}/board/raspberrypizero2w-64/post-image.sh"
BR2_LINUX_KERNEL=y
BR2_LINUX_KERNEL_CUSTOM_TARBALL=y
BR2_LINUX_KERNEL_CUSTOM_TARBALL_LOCATION="$(call github,raspberrypi,linux,95b85bebbedcaedfa7ca79116ed38b7376fba412)/linux-95b85bebbedcaedfa7ca79116ed38b7376fba412.tar.gz"
BR2_LINUX_KERNEL_USE_CUSTOM_CONFIG=y
BR2_LINUX_KERNEL_CUSTOM_CONFIG_FILE="${BR2_EXTERNAL}/configs/kernel/bcm2711_defconfig"
BR2_LINUX_KERNEL_DTS_SUPPORT=y
BR2_LINUX_KERNEL_INTREE_DTS_NAME="broadcom/bcm2710-rpi-zero-2-w"
BR2_LINUX_KERNEL_CUSTOM_DTS_PATH="${BR2_EXTERNAL}/configs/kernel/ptt_keys.dts ${BR2_EXTERNAL}/configs/kernel/ptt_codec_zero.dts"
BR2_LINUX_KERNEL_NEEDS_HOST_OPENSSL=y
BR2_PACKAGE_ALSA_UTILS=y
BR2_PACKAGE_ALSA_UTILS_APLAY=y
BR2_PACKAGE_GST1_PLUGINS_BASE_PLUGIN_AUDIOMIXER=y
BR2_PACKAGE_GST1_PLUGINS_BASE_PLUGIN_AUDIORATE=y
BR2_PACKAGE_GST1_PLUGINS_BASE_PLUGIN_ALSA=y
BR2_PACKAGE_GST1_PLUGINS_BASE_PLUGIN_OGG=y
BR2_PACKAGE_GST1_PLUGINS_BASE_PLUGIN_VORBIS=y
BR2_PACKAGE_GST1_PLUGINS_GOOD_PLUGIN_AUDIOPARSERS=y
# BR2_PACKAGE_GST1_PLUGINS_GOOD_PLUGIN_AVI is not set
# BR2_PACKAGE_GST1_PLUGINS_GOOD_PLUGIN_ISOMP4 is not set
BR2_PACKAGE_GST1_PLUGINS_GOOD_PLUGIN_RTP=y
BR2_PACKAGE_GST1_PLUGINS_GOOD_PLUGIN_RTSP=y
BR2_PACKAGE_GST1_PLUGINS_GOOD_PLUGIN_UDP=y
BR2_PACKAGE_MINIMODEM=y
BR2_PACKAGE_OPUS_TOOLS=y
BR2_PACKAGE_XZ=y
BR2_PACKAGE_BRCMFMAC_SDIO_FIRMWARE_RPI=y
BR2_PACKAGE_BRCMFMAC_SDIO_FIRMWARE_RPI_BT=y
BR2_PACKAGE_BRCMFMAC_SDIO_FIRMWARE_RPI_WIFI=y
BR2_PACKAGE_RPI_FIRMWARE=y
BR2_PACKAGE_RPI_FIRMWARE_BOOTCODE_BIN=y
BR2_PACKAGE_RPI_FIRMWARE_VARIANT_PI=y
BR2_PACKAGE_RPI_FIRMWARE_CONFIG_FILE="${BR2_EXTERNAL}/board/raspberrypizero2w-64/config_zero2w_64bit_iqaudio.txt"
BR2_PACKAGE_EVTEST=y
BR2_PACKAGE_PYTHON3=y
BR2_PACKAGE_PYTHON3_BZIP2=y
BR2_PACKAGE_PYTHON3_SSL=y
BR2_PACKAGE_PYTHON_CRYPTOGRAPHY=y
BR2_PACKAGE_PYTHON_PILLOW=y
BR2_PACKAGE_PYTHON_PYNACL=y
BR2_PACKAGE_PYTHON_SCAPY=y
BR2_PACKAGE_PYTHON_SPIDEV=y
BR2_PACKAGE_LIBCODEC2_EXAMPLES=y
BR2_PACKAGE_LIBGPIOD=y
BR2_PACKAGE_LIBGPIOD_TOOLS=y
BR2_PACKAGE_READLINE=y
BR2_PACKAGE_IPERF3=y
BR2_PACKAGE_IPROUTE2=y
BR2_PACKAGE_IW=y
BR2_PACKAGE_IWD=y
BR2_PACKAGE_NFTABLES=y
BR2_PACKAGE_OPENSSH=y
BR2_PACKAGE_RSYNC=y
BR2_PACKAGE_WIREGUARD_TOOLS=y
BR2_PACKAGE_WIRELESS_REGDB=y
BR2_PACKAGE_WIRELESS_TOOLS=y
BR2_PACKAGE_WPA_SUPPLICANT=y
BR2_PACKAGE_WPA_SUPPLICANT_OVERRIDES=y
BR2_PACKAGE_WPA_SUPPLICANT_HOTSPOT=y
BR2_PACKAGE_WPA_SUPPLICANT_WPA3=y
BR2_PACKAGE_WPA_SUPPLICANT_CLI=y
BR2_PACKAGE_WPA_SUPPLICANT_PASSPHRASE=y
BR2_PACKAGE_HTOP=y
BR2_PACKAGE_NANO=y
BR2_TARGET_ROOTFS_EXT2=y
BR2_TARGET_ROOTFS_EXT2_4=y
BR2_TARGET_ROOTFS_EXT2_SIZE="512M"
# BR2_TARGET_ROOTFS_TAR is not set
BR2_PACKAGE_HOST_DOSFSTOOLS=y
BR2_PACKAGE_HOST_GENIMAGE=y
BR2_PACKAGE_HOST_KMOD_XZ=y
BR2_PACKAGE_HOST_MTOOLS=y
BR2_PACKAGE_UDP2RAW=y
BR2_PACKAGE_UDPTUNNEL=y
BR2_PACKAGE_WSTUNNEL=y
BR2_PACKAGE_UDPPROXY=y
BR2_PACKAGE_SAMPLICATOR=y
BR2_PACKAGE_DPINGER=y
BR2_PACKAGE_AUDIORECEIVER=y
BR2_PACKAGE_AUDIOSTREAMER=y
BR2_PACKAGE_PTTCOMM=y
BR2_PACKAGE_C2PTT=y
BR2_PACKAGE_UDPPTT=y
```

## configs/rpi5_offline_pxe_defconfig
```kconfig
BR2_aarch64=y
BR2_cortex_a76=y
BR2_ARM_FPU_VFPV4=y
BR2_GLOBAL_PATCH_DIR="board/raspberrypi/patches"
BR2_DOWNLOAD_FORCE_CHECK_HASHES=y
BR2_LINUX_KERNEL=y
BR2_LINUX_KERNEL_CUSTOM_TARBALL=y
BR2_LINUX_KERNEL_CUSTOM_TARBALL_LOCATION="$(call github,raspberrypi,linux,21b410140c47ffab5668399f6f143c7d7b935c8b)/linux-21b410140c47ffab5668399f6f143c7d7b935c8b.tar.gz"
BR2_LINUX_KERNEL_DEFCONFIG="bcm2712"
BR2_LINUX_KERNEL_DTS_SUPPORT=y
BR2_LINUX_KERNEL_INTREE_DTS_NAME="broadcom/bcm2712-rpi-5-b broadcom/bcm2712d0-rpi-5-b"
BR2_LINUX_KERNEL_NEEDS_HOST_OPENSSL=y
BR2_PACKAGE_BUSYBOX_SHOW_OTHERS=y
BR2_PACKAGE_XZ=y
BR2_PACKAGE_RPI_FIRMWARE=y
BR2_PACKAGE_KMOD=y
BR2_PACKAGE_KMOD_TOOLS=y
BR2_TARGET_ROOTFS_EXT2=y
BR2_TARGET_ROOTFS_EXT2_4=y
# BR2_TARGET_ROOTFS_TAR is not set
BR2_PACKAGE_HOST_DOSFSTOOLS=y
BR2_PACKAGE_HOST_GENIMAGE=y
BR2_PACKAGE_HOST_KMOD_XZ=y
BR2_PACKAGE_HOST_MTOOLS=y
BR2_TOOLCHAIN_BUILDROOT_GLIBC=y
BR2_PACKAGE_HOST_LINUX_HEADERS_CUSTOM_6_12=y
BR2_INIT_SYSTEMD=y
BR2_TARGET_GENERIC_HOSTNAME="pxe-pi"
BR2_SYSTEM_DHCP=""
BR2_PACKAGE_SYSTEMD_NETWORKD=y
BR2_PACKAGE_SYSTEMD_RESOLVED=y
# BR2_PACKAGE_SYSTEMD_TIMESYNCD is not set
BR2_ROOTFS_OVERLAY="$(BR2_EXTERNAL_rpi_PATH)/board/rpi4-offline-pxe/rootfs-overlay $(BR2_EXTERNAL_rpi_PATH)/board/rpi5-offline-pxe/rootfs-overlay"
BR2_ROOTFS_POST_BUILD_SCRIPT="$(BR2_EXTERNAL_rpi_PATH)/board/rpi5-offline-pxe/post-build.sh"
BR2_ROOTFS_POST_IMAGE_SCRIPT="$(BR2_EXTERNAL_rpi_PATH)/board/rpi5-offline-pxe/post-image.sh"
BR2_LINUX_KERNEL_CONFIG_FRAGMENT_FILES="board/raspberrypi/linux-4k-page-size.fragment $(BR2_EXTERNAL_rpi_PATH)/board/rpi4-offline-pxe/linux.fragment $(BR2_EXTERNAL_rpi_PATH)/board/rpi5-offline-pxe/linux.fragment"
BR2_PACKAGE_RPI_FIRMWARE_CONFIG_FILE="$(BR2_EXTERNAL_rpi_PATH)/board/rpi5-offline-pxe/config.txt"
BR2_PACKAGE_RPI_FIRMWARE_CMDLINE_FILE="$(BR2_EXTERNAL_rpi_PATH)/board/rpi5-offline-pxe/cmdline.txt"
BR2_PACKAGE_DNSMASQ=y
BR2_PACKAGE_DNSMASQ_DHCP=y
BR2_PACKAGE_DNSMASQ_TFTP=y
BR2_PACKAGE_NGINX=y
BR2_PACKAGE_NGINX_HTTP=y
BR2_PACKAGE_E2FSPROGS=y
BR2_PACKAGE_E2FSPROGS_FSCK=y
BR2_PACKAGE_UTIL_LINUX=y
BR2_PACKAGE_UTIL_LINUX_BINARIES=y
BR2_PACKAGE_UTIL_LINUX_MOUNT=y
BR2_PACKAGE_UTIL_LINUX_WIPEFS=y
BR2_PACKAGE_UTIL_LINUX_HWCLOCK=y
BR2_PACKAGE_RSYNC=y
BR2_PACKAGE_IPROUTE2=y
BR2_PACKAGE_ETHTOOL=y
BR2_PACKAGE_TCPDUMP=y
BR2_PACKAGE_CA_CERTIFICATES=y
BR2_PACKAGE_OPENSSL=y
BR2_PACKAGE_LIBOPENSSL=y
BR2_PACKAGE_LIBCURL=y
BR2_PACKAGE_LIBCURL_CURL=y
BR2_PACKAGE_LIBCURL_OPENSSL=y
BR2_PACKAGE_LIBCURL_VERBOSE=y
# BR2_PACKAGE_LIBCURL_EXTRA_PROTOCOLS_FEATURES is not set
BR2_TARGET_ROOTFS_EXT2_SIZE="512M"
BR2_PACKAGE_HTOP=y
BR2_PACKAGE_NANO=y
# BR2_PACKAGE_NANO_TINY is not set
BR2_PACKAGE_IWD=y
BR2_PACKAGE_READLINE=y
BR2_PACKAGE_IW=y
BR2_PACKAGE_WIRELESS_REGDB=y
BR2_PACKAGE_BRCMFMAC_SDIO_FIRMWARE_RPI=y
BR2_PACKAGE_BRCMFMAC_SDIO_FIRMWARE_RPI_WIFI=y
BR2_PACKAGE_PYTHON3=y
BR2_PACKAGE_PYTHON3_SSL=y
BR2_PACKAGE_PYTHON3_XZ=y
BR2_PACKAGE_PYTHON3_ZLIB=y
BR2_PACKAGE_PYTHON3_BZIP2=y
BR2_PACKAGE_GNUPG2=y
BR2_PACKAGE_GNUPG2_GPGV=y
BR2_PACKAGE_OFFLINE_DEBIAN_KEYRING=y
```

## package/blinkstickctl/Config.in
```kconfig
config BR2_PACKAGE_BLINKSTICKCTL
	bool "blinkstickctl"
	select BR2_PACKAGE_LIBUSB
	help
	  Small C command-line utility for controlling a BlinkStick
	  RGB LED over USB using libusb-1.0.

	  https://codeberg.org/resiliencetheatre/blinkstickctl
```

## package/c2ptt/Config.in
```kconfig
config BR2_PACKAGE_C2PTT
        bool "c2ptt"
        select BR2_PACKAGE_GSTREAMER1
        select BR2_PACKAGE_GST1_PLUGINS_BASE
        help 
              c2ptt
```

## package/c2stream/Config.in
```kconfig
config BR2_PACKAGE_C2STREAM
        bool "c2stream"
        select BR2_PACKAGE_GSTREAMER1
        select BR2_PACKAGE_GST1_PLUGINS_BASE
        select BR2_PACKAGE_LIBCODEC2
        help 
              c2stream
```

## package/caddy/Config.in
```kconfig
config BR2_PACKAGE_CADDY
	bool "caddy"
	depends on BR2_PACKAGE_HOST_GO_TARGET_ARCH_SUPPORTS
	select BR2_PACKAGE_HOST_GO
	help
	  Caddy is an extensible web server with automatic HTTPS.

	  This package installs Caddy with a systemd service and a default
	  Caddyfile that terminates HTTPS on port 8443 and reverse-proxies
	  to 127.0.0.1:8080.

	  https://caddyserver.com/
```

## package/dokuwiki/Config.in
```kconfig
config BR2_PACKAGE_DOKUWIKI
	bool "dokuwiki"
	depends on BR2_PACKAGE_APACHE
	depends on BR2_PACKAGE_PHP
	select BR2_PACKAGE_PHP_SAPI_APACHE
	select BR2_PACKAGE_PHP_EXT_SESSION
	select BR2_PACKAGE_PHP_EXT_XML
	select BR2_PACKAGE_PHP_EXT_MBSTRING
	select BR2_PACKAGE_PHP_EXT_CTYPE
	select BR2_PACKAGE_PHP_EXT_FILTER
	select BR2_PACKAGE_PHP_EXT_FILEINFO
	select BR2_PACKAGE_PHP_EXT_ICONV
	select BR2_PACKAGE_PHP_EXT_OPENSSL
	select BR2_PACKAGE_PHP_EXT_ZLIB
	select BR2_PACKAGE_PHP_EXT_ZIP
	select BR2_PACKAGE_PHP_EXT_GD
	select BR2_PACKAGE_PHP_EXT_EXIF
	select BR2_PACKAGE_PHP_EXT_DOM
	select BR2_PACKAGE_PHP_EXT_SIMPLEXML
	select BR2_PACKAGE_CA_CERTIFICATES
	help
	  File-based wiki with bundled plugins and templates. PHP
	  support for sessions, XML, Unicode, images and archives.
	  Include /etc/apache2/extra/dokuwiki.conf from the Apache
	  configuration.
	  The webserver defconfig provides HTTPS and PHP support.

	  https://www.dokuwiki.org
```

## package/edgemap/Config.in
```kconfig
config BR2_PACKAGE_EDGEMAP
    bool "edgemap"
    help
      Installs edgemap web assets under /opt/edgemap.
```

## package/fidohmac/Config.in
```kconfig
config BR2_PACKAGE_FIDOHMAC
	bool "fidohmac"
	help
	  Small command-line utility from the Resilience Theatre
	  fidohmac project.
	  
	  Source repository:
	  https://codeberg.org/resiliencetheatre/fidohmac
```

## package/forgejo/Config.in
```kconfig
config BR2_PACKAGE_FORGEJO
	bool "forgejo"
	depends on BR2_PACKAGE_HOST_GO_TARGET_ARCH_SUPPORTS
	depends on BR2_TOOLCHAIN_HAS_THREADS
	depends on BR2_USE_MMU
	select BR2_PACKAGE_GIT
	select BR2_PACKAGE_OPENSSH
	select BR2_PACKAGE_BASH
	help
	  Forgejo self-hosted Git forge.

	  This package builds Forgejo from source using host Go and
	  host Node.js/npm. The final target image receives the Forgejo
	  binary plus runtime dependencies such as git and openssh.

	  Runtime data is expected under /var/lib/forgejo.
	  Configuration is expected under /etc/forgejo/app.ini.

	  https://forgejo.org/

comment "forgejo needs a toolchain with threads and MMU"
	depends on !BR2_TOOLCHAIN_HAS_THREADS || !BR2_USE_MMU
```

## package/hsmproxy/Config.in
```kconfig
config BR2_PACKAGE_HSMPROXY
	bool "hsmproxy"
	depends on BR2_USE_MMU # pcsc-lite, opensc, p11-kit
	depends on !BR2_STATIC_LIBS # dlopen, pcsc-lite, opensc, p11-kit
	depends on BR2_TOOLCHAIN_HAS_THREADS
	depends on BR2_TOOLCHAIN_GCC_AT_LEAST_4_9 # pcsc-lite, ccid
	select BR2_PACKAGE_OPENSSL
	select BR2_PACKAGE_PCSC_LITE
	select BR2_PACKAGE_P11_KIT
	select BR2_PACKAGE_OPENSC
	select BR2_PACKAGE_CCID
	help
	  SmartCard-HSM authenticated, encrypted UDP proxy for video,
	  audio and text channels. Uses OpenSSL and OpenSC PKCS#11 over
	  PC/SC, with USB CCID smartcard reader support.

	  Provision card identities and a peer configuration before
	  starting hsmproxy manually with --config. The card PIN is
	  supplied interactively or through --pin-fd.

	  https://github.com/resiliencetheatre/hsmproxy

comment "hsmproxy needs a toolchain w/ threads, dynamic library, gcc >= 4.9"
	depends on BR2_USE_MMU
	depends on !BR2_TOOLCHAIN_HAS_THREADS || BR2_STATIC_LIBS || \
		!BR2_TOOLCHAIN_GCC_AT_LEAST_4_9
```

## package/inn2/Config.in
```kconfig
config BR2_PACKAGE_INN2
	bool "inn2"
	depends on BR2_USE_MMU
	help
	  INN (InterNetNews) is a complete Usenet/Netnews server.
	  It provides innd for server-to-server feeds and nnrpd for
	  newsreader access over NNTP.

	  This package builds the core server without embedded Perl,
	  Python, Berkeley DB, Cyrus SASL, Kerberos, or libcanlock
	  support by default.

	  https://github.com/InterNetNews/inn

if BR2_PACKAGE_INN2

config BR2_PACKAGE_INN2_ZLIB
	bool "zlib compression support"
	select BR2_PACKAGE_ZLIB
	help
	  Enable NNTP COMPRESS support and compression support for
	  overview backends that can use zlib.

config BR2_PACKAGE_INN2_OPENSSL
	bool "TLS support"
	select BR2_PACKAGE_OPENSSL
	help
	  Enable TLS support in nnrpd using OpenSSL.

config BR2_PACKAGE_INN2_SQLITE
	bool "SQLite overview/history support"
	select BR2_PACKAGE_SQLITE
	help
	  Enable the ovsqlite overview backend and hissqlite history
	  backend.

endif
```

## package/knock-daemon/Config.in
```kconfig
config BR2_PACKAGE_KNOCK_DAEMON
	bool "knock-daemon"
	help
	  Small port-knock related utilities:
	    - knock-send
	    - knock-receiver

	  https://codeberg.org/resiliencetheatre/knock-daemon
```

## package/libcbor/Config.in
```kconfig
config BR2_PACKAGE_LIBCBOR
	bool "libcbor"
	help
	  libcbor is a C library for the Concise Binary Object Representation
	  (CBOR, RFC 8949). It provides encoding/decoding primitives and a
	  DOM-like API for manipulating CBOR data.

	  https://github.com/PJK/libcbor
```
