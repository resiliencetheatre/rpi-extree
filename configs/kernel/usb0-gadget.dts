/dts-v1/;
/plugin/;

/ {
    compatible = "raspberrypi,5-model-b";

    fragment@0 {
        target-path = "/soc/usb@fe980000";
        __overlay__ {
            dr_mode = "peripheral";
            status = "okay";
        };
    };

    fragment@1 {
        target-path = "/soc/usb-phy@fe980000";
        __overlay__ {
            status = "okay";
        };
    };
};
