## package/lvgl-com/Config.in
```kconfig
config BR2_PACKAGE_LVGL_COM
	bool "lvgl-com"
	depends on BR2_INSTALL_LIBSTDCPP
	depends on BR2_TOOLCHAIN_HAS_THREADS
	select BR2_PACKAGE_LIBPNG
	help
	  LVGL communications UI from the lvgl-com Git repository.
	  Supports framebuffer and Wayland presentation.

if BR2_PACKAGE_LVGL_COM

config BR2_PACKAGE_LVGL_COM_WAYLAND
	bool "Wayland backend"
	depends on !BR2_STATIC_LIBS
	select BR2_PACKAGE_WAYLAND
	select BR2_PACKAGE_WAYLAND_PROTOCOLS
	select BR2_PACKAGE_LIBXKBCOMMON
	help
	  Render the UI into Wayland shared-memory buffers. Weston owns
	  the display and input devices. Without this option, use fbdev.

endif

comment "lvgl-com needs a toolchain w/ C++, threads"
	depends on !BR2_INSTALL_LIBSTDCPP || !BR2_TOOLCHAIN_HAS_THREADS
```

## package/lvgl-console-local/Config.in
```kconfig
config BR2_PACKAGE_LVGL_CONSOLE_LOCAL
	bool "lvgl-console-local"
	depends on BR2_INSTALL_LIBSTDCPP
	depends on BR2_TOOLCHAIN_HAS_THREADS_NPTL
	depends on BR2_USE_MMU
	depends on !BR2_PACKAGE_LVGL_CONSOLE
	select BR2_PACKAGE_LIBPNG
	select BR2_PACKAGE_ALSA_LIB
	select BR2_PACKAGE_ALSA_LIB_MIXER
	help
	  Build the LVGL framebuffer console from the local lvgl-console
	  directory beside this external tree, for development without
	  committing or downloading sources. Includes the console
	  launcher.

	  Disable lvgl-console first: both packages install the same
	  files.
	  Run make lvgl-console-local-rebuild after editing sources.

comment "lvgl-console-local needs a toolchain w/ C++, NPTL"
	depends on BR2_USE_MMU
	depends on !BR2_INSTALL_LIBSTDCPP || !BR2_TOOLCHAIN_HAS_THREADS_NPTL

comment "lvgl-console-local needs lvgl-console disabled"
	depends on BR2_PACKAGE_LVGL_CONSOLE
```

## package/lvgl-console/Config.in
```kconfig
config BR2_PACKAGE_LVGL_CONSOLE
	bool "lvgl-console"
	depends on BR2_INSTALL_LIBSTDCPP
	depends on BR2_TOOLCHAIN_HAS_THREADS_NPTL
	depends on BR2_USE_MMU
	select BR2_PACKAGE_LIBPNG
	select BR2_PACKAGE_ALSA_LIB
	select BR2_PACKAGE_ALSA_LIB_MIXER
	help
	  LVGL 9.6.0 framebuffer console with a tabbed interface, link
	  logo, and placeholder Connect and Disconnect buttons.
	  Uses evdev for touchscreen input.

	  https://github.com/resiliencetheatre/lvgl-console

comment "lvgl-console needs a toolchain w/ C++, NPTL"
	depends on BR2_USE_MMU
	depends on !BR2_INSTALL_LIBSTDCPP || !BR2_TOOLCHAIN_HAS_THREADS_NPTL
```

## package/lvgl-video/Config.in
```kconfig
config BR2_PACKAGE_LVGL_VIDEO
	bool "lvgl-video"
	depends on BR2_INSTALL_LIBSTDCPP
	depends on BR2_TOOLCHAIN_HAS_THREADS_NPTL
	depends on BR2_USE_MMU
	depends on BR2_USE_WCHAR
	depends on BR2_PACKAGE_WEBRTC_AUDIO_PROCESSING_ARCH_SUPPORTS
	depends on BR2_PACKAGE_LIBABSEIL_CPP_ARCH_SUPPORTS
	depends on BR2_TOOLCHAIN_GCC_AT_LEAST_10
	depends on !BR2_STATIC_LIBS
	depends on BR2_PACKAGE_LIBCAMERA
	select BR2_PACKAGE_GSTREAMER1
	select BR2_PACKAGE_GSTREAMER1_PARSE
	select BR2_PACKAGE_GST1_PLUGINS_BASE
	select BR2_PACKAGE_GST1_PLUGINS_BASE_PLUGIN_APP
	select BR2_PACKAGE_GST1_PLUGINS_BASE_PLUGIN_AUDIOCONVERT
	select BR2_PACKAGE_GST1_PLUGINS_BASE_PLUGIN_AUDIORESAMPLE
	select BR2_PACKAGE_GST1_PLUGINS_BASE_PLUGIN_ALSA
	select BR2_PACKAGE_GST1_PLUGINS_BASE_PLUGIN_OPUS
	select BR2_PACKAGE_GST1_PLUGINS_BAD
	select BR2_PACKAGE_GST1_PLUGINS_BAD_PLUGIN_WEBRTCDSP
	select BR2_PACKAGE_GST1_PLUGINS_GOOD
	select BR2_PACKAGE_GST1_PLUGINS_GOOD_PLUGIN_RTP
	select BR2_PACKAGE_GST1_PLUGINS_GOOD_PLUGIN_RTPMANAGER
	select BR2_PACKAGE_GST1_PLUGINS_GOOD_PLUGIN_UDP
	select BR2_PACKAGE_GST1_PLUGINS_GOOD_PLUGIN_V4L2
	select BR2_PACKAGE_GST1_PLUGINS_GOOD_PLUGIN_VPX
	select BR2_PACKAGE_GST1_PLUGINS_BASE_PLUGIN_VIDEOCONVERTSCALE
	help
	  Local camera preview and GTK Pipe-compatible VP8/Opus RTP
	  conferencing at fixed 640x480, 10 fps.
	  Uses ALSA audio with optional WebRTC echo cancellation.
	  Supports framebuffer and Wayland presentation.

if BR2_PACKAGE_LVGL_VIDEO

config BR2_PACKAGE_LVGL_VIDEO_WAYLAND
	bool "Wayland backend"
	depends on !BR2_STATIC_LIBS
	select BR2_PACKAGE_WAYLAND
	select BR2_PACKAGE_WAYLAND_PROTOCOLS
	select BR2_PACKAGE_LIBXKBCOMMON
	help
	  Render the UI into Wayland shared-memory buffers. Weston owns
	  the display and input devices. Without this option, use fbdev.

endif

comment "lvgl-video needs libcamera and a toolchain w/ C++, NPTL, wchar"
	depends on BR2_USE_MMU
	depends on !BR2_INSTALL_LIBSTDCPP || !BR2_TOOLCHAIN_HAS_THREADS_NPTL || \
		!BR2_USE_WCHAR || !BR2_PACKAGE_LIBCAMERA
```

## package/offline-debian-keyring/Config.in
```kconfig
config BR2_PACKAGE_OFFLINE_DEBIAN_KEYRING
	bool "Debian archive public keyring for offline updater"
	help
	  Pinned Debian archive verification keys; contains no private keys.
```

## package/opusstreamer/Config.in
```kconfig
config BR2_PACKAGE_OPUSSTREAMER
        bool "opusstreamer"
        select BR2_PACKAGE_GSTREAMER1
        select BR2_PACKAGE_GST1_PLUGINS_BASE
        help 
              debugging version of opus streamer
```

## package/python-adafruit-circuitpython-rgb-display/Config.in
```kconfig
config BR2_PACKAGE_PYTHON_ADAFRUIT_CIRCUITPYTHON_RGB_DISPLAY
	bool "python-adafruit-circuitpython-rgb-display"
	help
	Port of display drivers from 
	https://github.com/adafruit/micropython-adafruit-rgb-display 
	to Adafruit CircuitPython for use on Adafruit’s SAMD21-based 
	and other CircuitPython boards.

	  https://pypi.org/project/adafruit-circuitpython-rgb-display/
```

## package/python-irc/Config.in
```kconfig
config BR2_PACKAGE_PYTHON_IRC
	bool "python-irc"
	help
	
	  https://pypi.org/project/irc
```

## package/python-meshtastic/Config.in
```kconfig
config BR2_PACKAGE_PYTHON_MESHTASTIC
	bool "python-meshtastic"
	select BR2_PACKAGE_PYTHON_SERIAL
	select BR2_PACKAGE_PYTHON_PROTOBUF
	select BR2_PACKAGE_PYTHON_REQUESTS
	select BR2_PACKAGE_PYTHON_PYYAML
	select BR2_PACKAGE_PYTHON_PYPUBSUB
	select BR2_PACKAGE_PYTHON_BLEAK
	select BR2_PACKAGE_PYTHON_PACKAGING
	select BR2_PACKAGE_PYTHON_TABULATE
	help
	  Python client for Meshtastic devices.

	  https://github.com/meshtastic/python
```

## package/python-nomadnet/Config.in
```kconfig
config BR2_PACKAGE_PYTHON_NOMADNET
	bool "python-nomadnet"
	select BR2_PACKAGE_PYTHON_RNS
	select BR2_PACKAGE_PYTHON_LXMF
	select BR2_PACKAGE_PYTHON_URWID
	select BR2_PACKAGE_PYTHON_QRCODE
	help
	  Nomad Network is a resilient, encrypted communication
	  system built on Reticulum and LXMF.

	  https://github.com/markqvist/NomadNet
```

## package/python-pygmc/Config.in
```kconfig
config BR2_PACKAGE_PYTHON_PYGMC
	bool "python-pygmc"
	help
	
	  PyGMC is a Python API for Geiger–Müller Counters (GMCs) / Geiger Counters.
          https://pypi.org/project/pygmc/
```

## package/python-pypubsub/Config.in
```kconfig
config BR2_PACKAGE_PYTHON_PYPUBSUB
	bool "python-pypubsub"
	help
	  PyPubSub provides a Python publish-subscribe API.

	  https://pypi.org/project/PyPubSub/
```

## package/python-taky-ng/Config.in
```kconfig
config BR2_PACKAGE_PYTHON_TAKY_NG
	bool "python-taky-ng"
	depends on BR2_PACKAGE_PYTHON3
	select BR2_PACKAGE_PYTHON_LXML
	select BR2_PACKAGE_PYTHON_CRYPTOGRAPHY
	select BR2_PACKAGE_PYTHON_DATEUTIL
	select BR2_PACKAGE_PYTHON_FLASK
	select BR2_PACKAGE_PYTHON_GUNICORN
	select BR2_PACKAGE_PYTHON_REDIS
	help
	  A simple TAK server and COT router.

	  https://codeberg.org/hunterSG7/taky-ng
```

## package/rclone/Config.in
```kconfig
config BR2_PACKAGE_RCLONE
	bool "rclone"
	depends on BR2_PACKAGE_HOST_GO_TARGET_ARCH_SUPPORTS
	help
	  Rclone is a command-line program for managing files on
	  cloud storage.

	  It supports S3-compatible storage, WebDAV, SFTP, Google
	  Drive, Dropbox, Microsoft OneDrive and many other storage
	  providers.

	  https://rclone.org/

comment "rclone needs a toolchain supported by Go"
	depends on !BR2_PACKAGE_HOST_GO_TARGET_ARCH_SUPPORTS
```

## package/reterminal-drivers/Config.in
```kconfig
config BR2_PACKAGE_RETERMINAL_DRIVERS
	bool "reTerminal display and touch driver"
	depends on BR2_LINUX_KERNEL
	depends on BR2_aarch64
	help
	  Seeed Studio's STM32/ILI9881 display, backlight and touch
	  driver for the original CM4 reTerminal (not reTerminal DM).
```

## package/rpi-tryboot-firmware/Config.in
```kconfig
config BR2_PACKAGE_RPI_TRYBOOT_FIRMWARE
	bool "CM4 USB GPT tryboot firmware fix"
	depends on BR2_aarch64
	depends on BR2_PACKAGE_RPI_FIRMWARE_VARIANT_PI4
	help
	  Matched start4.elf/fixup4.dat pair fixing GPT detection for
	  USB boot with autoboot.txt (raspberrypi/firmware#2047).
	  Used only by the opt-in reTerminal A/B image.
	  Does not update EEPROM.
```

## package/secure-audio/Config.in
```kconfig
config BR2_PACKAGE_SECURE_AUDIO
	bool "secure-audio"
	select BR2_PACKAGE_LIBCODEC2
	select BR2_PACKAGE_LIQUID_DSP
	help
	  Build the secure-audio Codec2 transport and project-owned MSK modem
	  tools. securetx and securerx process Codec2 transport frames, while
	  modemtx and modemrx convert framed data to and from 48 kHz mono PCM.

	  This package contains no encryption, FEC, or full-duplex support.
```

## package/situation-map/Config.in
```kconfig
config BR2_PACKAGE_SITUATION_MAP
	bool "situation-map"
	depends on BR2_USE_MMU
	depends on BR2_USE_WCHAR
	depends on BR2_TOOLCHAIN_HAS_THREADS
	depends on !BR2_STATIC_LIBS
	select BR2_PACKAGE_PYTHON3
	select BR2_PACKAGE_PYTHON3_SQLITE
	help
	  Situation is a small offline-capable situation-awareness web
	  application using MapLibre GL JS, PMTiles and a Python standard
	  library HTTP server with a local SQLite position database.

	  The package installs the application under /opt/situation.
	  PMTiles map archives are deployment data and are not included.

	  https://github.com/resiliencetheatre/map

if BR2_PACKAGE_SITUATION_MAP

config BR2_PACKAGE_SITUATION_MAP_TAK
	bool "install TAK bridge"
	select BR2_PACKAGE_PYTHON3_PYEXPAT
	help
	  Install tak-bridge.py and its systemd service. The bridge receives
	  Cursor-on-Target XML over plain TCP and forwards positions to the
	  local Situation API.

	  The service is installed but not enabled automatically.

config BR2_PACKAGE_SITUATION_MAP_MESHTASTIC
	bool "install Meshtastic adapter"
	select BR2_PACKAGE_PYTHON_MESHTASTIC
	help
	  Install meshtastic-plugin.py and its systemd service.

	  This assumes BR2_PACKAGE_PYTHON_MESHTASTIC is provided by your
	  external tree. The service uses Meshtastic's serial auto-detection
	  by default and is installed but not enabled automatically.

endif
```

## package/spacecom/Config.in
```kconfig
config BR2_PACKAGE_SPACECOM
	bool "spacecom"
	depends on BR2_INSTALL_LIBSTDCPP
	depends on BR2_TOOLCHAIN_HAS_THREADS
	select BR2_PACKAGE_NORM
	help
	  spacecom-send and spacecom-recv utilities built on top of NORM.

comment "spacecom needs a toolchain w/ C++, threads"
	depends on !BR2_INSTALL_LIBSTDCPP || !BR2_TOOLCHAIN_HAS_THREADS
```

## package/udpptt/Config.in
```kconfig
config BR2_PACKAGE_UDPPTT
	bool "udpptt"
	depends on BR2_TOOLCHAIN_HAS_THREADS
	depends on !BR2_STATIC_LIBS
	select BR2_PACKAGE_GSTREAMER1
	select BR2_PACKAGE_GST1_PLUGINS_BASE
	select BR2_PACKAGE_GST1_PLUGINS_BASE_PLUGIN_APP
	select BR2_PACKAGE_GST1_PLUGINS_BASE_PLUGIN_AUDIOCONVERT
	select BR2_PACKAGE_GST1_PLUGINS_BASE_PLUGIN_AUDIORESAMPLE
	select BR2_PACKAGE_GST1_PLUGINS_BASE_PLUGIN_OPUS
	select BR2_PACKAGE_GST1_PLUGINS_GOOD
	select BR2_PACKAGE_GST1_PLUGINS_GOOD_PLUGIN_AUTODETECT
	select BR2_PACKAGE_GST1_PLUGINS_GOOD_PLUGIN_WAVPARSE
	select BR2_PACKAGE_LIBSODIUM
	help
	  udpptt is a simple UDP push-to-talk audio test application with
	  a client/server model.

	  It builds two target binaries:
	    - /usr/bin/ptt_client
	    - /usr/bin/ptt_server

if BR2_PACKAGE_UDPPTT

config BR2_PACKAGE_UDPPTT_SITE
	string "udpptt source directory"
	default "$(BR2_EXTERNAL_$(BR2_EXTERNAL_NAME)_PATH)/../udpptt"
	help
	  Path to the udpptt project source directory containing:
	    - ptt_client.c
	    - ptt_server.c
	    - Makefile (optional)

	  This package uses SITE_METHOD=local, so the directory is copied
	  into the Buildroot build tree before compilation.

endif
```

## package/utxtrelay/Config.in
```kconfig
config BR2_PACKAGE_UTXTRELAY
	bool "utxtrelay"
	depends on BR2_USE_MMU
	select BR2_PACKAGE_LIBSODIUM
	help
	  UDP text relay server, terminal client, and Unix-domain socket
	  connector for lvgl-console. Builds the adjacent utxtrelay
	  source directory without ncurses.

	  https://github.com/resiliencetheatre/utxtrelay
```
