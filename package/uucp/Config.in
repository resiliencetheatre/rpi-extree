## package/uucp/Config.in
```kconfig
config BR2_PACKAGE_UUCP
	bool "uucp"
	depends on BR2_USE_MMU
	help
	  Taylor UUCP (Unix-to-Unix Copy) provides store-and-forward
	  file transfer and remote command execution, including uucico,
	  uucp, uux, uuxqt, uustat, uulog and related utilities.

	  This package is useful for intermittently connected systems and
	  can operate over TCP, including TCP carried over WireGuard.

	  https://www.gnu.org/software/uucp/
```

## package/uxplay/Config.in
```kconfig
config BR2_PACKAGE_UXPLAY
	bool "uxplay"
	depends on BR2_USE_MMU # avahi
	depends on BR2_INSTALL_LIBSTDCPP
	depends on BR2_TOOLCHAIN_HAS_THREADS
	depends on BR2_USE_WCHAR # gstreamer1
	depends on !BR2_STATIC_LIBS # avahi
	depends on BR2_PACKAGE_FFMPEG_ARCH_SUPPORTS
	select BR2_PACKAGE_AVAHI
	select BR2_PACKAGE_AVAHI_DAEMON
	select BR2_PACKAGE_AVAHI_LIBDNSSD_COMPATIBILITY
	select BR2_PACKAGE_OPENSSL
	select BR2_PACKAGE_LIBPLIST
	select BR2_PACKAGE_GSTREAMER1
	select BR2_PACKAGE_GSTREAMER1_PARSE
	select BR2_PACKAGE_GST1_PLUGINS_BASE
	select BR2_PACKAGE_GST1_PLUGINS_BASE_PLUGIN_APP
	select BR2_PACKAGE_GST1_PLUGINS_BASE_PLUGIN_AUDIOCONVERT
	select BR2_PACKAGE_GST1_PLUGINS_BASE_PLUGIN_AUDIORESAMPLE
	select BR2_PACKAGE_GST1_PLUGINS_BASE_PLUGIN_VOLUME
	select BR2_PACKAGE_GST1_PLUGINS_GOOD
	select BR2_PACKAGE_GST1_PLUGINS_BAD
	select BR2_PACKAGE_GST1_PLUGINS_BAD_PLUGIN_VIDEOPARSERS
	select BR2_PACKAGE_GST1_LIBAV
	select BR2_PACKAGE_GST1_PLUGINS_GOOD_PLUGIN_ISOMP4
	select BR2_PACKAGE_GST1_PLUGINS_GOOD_PLUGIN_LEVEL
	select BR2_PACKAGE_GST1_PLUGINS_GOOD_PLUGIN_RTP # bundled service
	select BR2_PACKAGE_GST1_PLUGINS_GOOD_PLUGIN_UDP # bundled service
	help
	  UxPlay is an AirPlay mirroring and audio-streaming server.

	  https://github.com/FDH2/UxPlay
```

## package/vcgencmd/Config.in
```kconfig
config BR2_PACKAGE_VCGENCMD
	bool "vcgencmd"
	depends on BR2_arm || BR2_aarch64
	help
	  Raspberry Pi VideoCore diagnostic command-line utility, including
	  bootloader_version, bootloader_config, temperature and throttling.
	  Requires the Raspberry Pi firmware and BCM_VCIO kernel drivers.

	  https://github.com/raspberrypi/utils/tree/master/vcgencmd
```

## package/wstunnel/Config.in
```kconfig
config BR2_PACKAGE_WSTUNNEL
    bool "wstunnel"
    depends on BR2_PACKAGE_HOST_RUSTC_TARGET_ARCH_SUPPORTS
    select BR2_PACKAGE_HOST_RUSTC
    help
      Tunnel TCP/UDP over WebSocket/HTTP2.
      https://github.com/erebe/wstunnel
```
